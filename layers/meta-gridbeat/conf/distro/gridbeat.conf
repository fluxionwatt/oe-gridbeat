## layers/meta-gridbeat/conf/distro/gridbeat.conf
```bitbake
# 基于 poky
require conf/distro/poky.conf

DISTRO_NAME = "GridBeat"
DISTRO_VERSION = "1.0"

# systemd（也可只放 local.conf；但你要求“统一发行版层”，建议固化在 distro）
DISTRO_FEATURES:append = " systemd"
DISTRO_FEATURES:remove = " sysvinit"
VIRTUAL-RUNTIME_init_manager = "systemd"

# 你也可以在这里固化一些默认策略（如开启 ipv6/蓝牙等），按项目需要扩展
DISTRO_FEATURES:append = " usrmerge"
```

## layers/meta-gridbeat/conf/layer.conf
```bitbake
BBPATH .= ":${LAYERDIR}"

BBFILE_COLLECTIONS += "gridbeat"
BBFILE_PATTERN_gridbeat = "^${LAYERDIR}/"
BBFILE_PRIORITY_gridbeat = "60"

BBFILES += " \
  ${LAYERDIR}/recipes-*/*/*.bb \
  ${LAYERDIR}/recipes-*/*/*.bbappend \
"
LAYERSERIES_COMPAT_gridbeat = "walnascar"
```
